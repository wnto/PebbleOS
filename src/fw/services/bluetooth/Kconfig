## src/fw/services/bluetooth/Kconfig
```kconfig
# SPDX-FileCopyrightText: 2026 Core Devices LLC
# SPDX-License-Identifier: Apache-2.0

config SERVICE_BLUETOOTH
    bool "Bluetooth"
    help
      Core Bluetooth service (pairing, bonding, local id, ...).

config BLE_GATT_NOTIF_WRITE_TIMEOUT_MS
    int "GATT notification handoff timeout (ms)"
    default 5 if SOC_SF32LB52
    default 100
    help
      Max time the BT host task blocks for the client to drain the per-client
      GATT subscription buffer before dropping a notification. Must stay below
      the HCI transport's tolerance for a stalled host.

config BLE_GATT_SUBSCRIPTION_DEPTH
    int "GATT subscription buffer depth (notifications)"
    default 8 if SOC_SF32LB52
    default 4
    help
      Per-client GATT subscription buffer depth, in max-size notifications.
      Deeper absorbs notification bursts (fewer drops) at the cost of RAM.

config BT_MAX_BLE_PAIRINGS
    int "Maximum number of paired phones"
    range 1 2
    default 2
    help
      How many phones the watch remembers at once. It is connected to one
      of them at a time. With 1, pairing a phone replaces the previous one.
      With 2, whichever bonded phone connects becomes the active gateway,
      and pairing a third phone forgets the other, not the active gateway.

      Every bonded phone takes an entry of the controller's resolving list,
      and NimBLE uses one more for the local IRK. The SiFli SDK's default
      configuration of the SF32LB52 controller has 3 entries, hence at
      most 2.

config BT_ANCS_CLIENT
    bool "ANCS (Apple Notification Center Service) client"
    default y if !RECOVERY_FW
    help
      Build the ANCS GATT client (iOS notifications). Off in the recovery
      firmware, which has no notification UI.

config BT_AMS_CLIENT
    bool "AMS (Apple Media Service) client"
    default y if !RECOVERY_FW
    help
      Build the AMS GATT client (iOS music control). Off in the recovery
      firmware, which has no music UI.

if SERVICE_BLUETOOTH

module = SERVICE_BLUETOOTH
module-str = Bluetooth
source "subsys/logging/Kconfig.template.log_level"

endif
```
